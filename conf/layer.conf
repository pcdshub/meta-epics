## conf/layer.conf
```bitbake
# We have a conf and classes directory, add to BBPATH
BBPATH .= ":${LAYERDIR}"

# We have recipes-* directories, add to BBFILES
BBFILES += "${LAYERDIR}/recipes-*/*/*.bb \
            ${LAYERDIR}/recipes-*/*/*.bbappend"

BBFILE_COLLECTIONS += "meta-epics"
BBFILE_PATTERN_meta-epics = "^${LAYERDIR}/"
BBFILE_PRIORITY_meta-epics = "6"

LAYERDEPENDS_meta-epics = "core"
LAYERSERIES_COMPAT_meta-epics = "scarthgap"

addpylib ${LAYERDIR}/python epics
```
